// SPDX-License-Identifier: (GPL-2.0 OR MIT)
/* Bring-up variant: everything (PCIe included) plus the display, the EC/input devices, USB, the IOMMU, thermal, audio, video decode, HDMI and USB-C DisplayPort. */
#include "mt8189-quigon.dts"
#include "mt8189-quigon-display.dtsi"
#include "mt8189-quigon-input.dtsi"
#include "mt8189-quigon-usb.dtsi"
#include "mt8189-quigon-iommu.dtsi"
#include "mt8189-quigon-thermal.dtsi"
#include "mt8189-quigon-audio.dtsi"
#include "mt8189-quigon-vcodec.dtsi"
#include "mt8189-quigon-hdmi.dtsi"
#include "mt8189-quigon-dp.dtsi"
#include "mt8189-quigon-suspend.dtsi"
