// SPDX-License-Identifier: (GPL-2.0 OR MIT)
/* Bring-up variant: mt8189-quigon-nopcie plus the internal display (eDP panel, backlight) and the EC (keyboard,
 * battery), touchpad, touchscreen and USB. */
#include "mt8189-quigon-nopcie.dts"
#include "mt8189-quigon-display.dtsi"
#include "mt8189-quigon-input.dtsi"
#include "mt8189-quigon-usb.dtsi"
